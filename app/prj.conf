## CMakeLists.txt
```
# SPDX-License-Identifier: Apache-2.0
cmake_minimum_required(VERSION 3.20.0)
find_package(Zephyr REQUIRED HINTS $ENV{ZEPHYR_BASE})
project(k64f_hid_injector)

target_sources(app PRIVATE
  src/main.c
  src/usbd_ctx.c
  src/hid_io.c
  src/command.c
)
```

## prj.conf
```kconfig
# USB device stack (the "next" stack; the legacy one is deprecated) with HID.
CONFIG_USB_DEVICE_STACK_NEXT=y
CONFIG_USBD_HID_SUPPORT=y
CONFIG_CDC_ACM_SERIAL_INITIALIZE_AT_BOOT=n

# Serial number descriptor is derived from the SoC unique id.
CONFIG_HWINFO=y

# The OpenSDA CDC port is the console; the command protocol speaks over it.
CONFIG_CONSOLE_SUBSYS=y
CONFIG_CONSOLE_GETLINE=y

# Keep logging quiet so it does not interleave with protocol replies. Warnings
# and errors still surface, and every reply is prefixed OK/ERR so a host parser
# can ignore anything else.
CONFIG_LOG=y
CONFIG_LOG_MODE_MINIMAL=y
CONFIG_USBD_LOG_LEVEL_WRN=y
CONFIG_USBD_HID_LOG_LEVEL_WRN=y
CONFIG_UDC_DRIVER_LOG_LEVEL_WRN=y

CONFIG_MAIN_STACK_SIZE=4096
CONFIG_BUILD_OUTPUT_HEX=y
```

## app.overlay
```dts
/*
 * Two separate HID interfaces rather than one interface with report IDs.
 * Boot protocol is only defined for a keyboard or a mouse individually, so
 * splitting them keeps both usable by a BIOS or bootloader that only speaks
 * boot protocol, and keeps the reports free of a leading report-ID byte.
 *
 * SPDX-License-Identifier: Apache-2.0
 */

/ {
	hid_kbd: hid_kbd {
		compatible = "zephyr,hid-device";
		label = "K64F HID Keyboard";
		protocol-code = "keyboard";
		in-report-size = <8>;
		in-polling-period-us = <1000>;
	};

	hid_mouse: hid_mouse {
		compatible = "zephyr,hid-device";
		label = "K64F HID Mouse";
		protocol-code = "mouse";
		in-report-size = <4>;
		in-polling-period-us = <1000>;
	};
};
```

## src/main.c
```c
/*
 * FRDM-K64F HID injector.
 *
 * The board's native USB port presents a keyboard and a mouse to the target
 * (the Jetson). Commands arrive on the OpenSDA CDC console and are turned into
 * HID reports. See command.c for the protocol, or send HELP.
 *
 * SPDX-License-Identifier: Apache-2.0
 */

#include "command.h"
#include "hid_io.h"
#include "usbd_ctx.h"

#include <zephyr/console/console.h>
#include <zephyr/kernel.h>
#include <zephyr/usb/usbd.h>

static void serial_reply(void *ctx, const char *line)
{
	ARG_UNUSED(ctx);
	printk("%s\n", line);
}

int main(void)
{
	struct usbd_context *usbd;
	int ret;

	printk("boot: starting\n");

	/* HID classes must be registered before the device is initialised,
	   since usbd_register_all_classes() walks what is already there. */
	ret = hid_io_init();
	if (ret) {
		printk("ERR HID INIT FAILED %d\n", ret);
		return 0;
	}

	printk("boot: hid_io_init ok\n");

	usbd = k64f_usbd_init();
	if (usbd == NULL) {
		printk("ERR USB INIT FAILED\n");
		return 0;
	}

	printk("boot: usbd_init ok\n");

	ret = usbd_enable(usbd);
	if (ret) {
		printk("ERR USB ENABLE FAILED %d\n", ret);
		return 0;
	}

	printk("boot: usbd_enable ok\n");

	console_getline_init();

	printk("k64f-hid-injector ready, send HELP\n");

	while (true) {
		char *line = console_getline();

		if (line != NULL) {
			command_execute(line, serial_reply, NULL);
		}
	}

	return 0;
}
```

## src/command.c
```c
/*
 * ASCII line protocol. Every command answers exactly one line beginning OK or
 * ERR, matching the convention used by the relay controller on this bench so
 * host tooling can treat both the same way.
 *
 * SPDX-License-Identifier: Apache-2.0
 */

#include "command.h"
#include "hid_io.h"

#include <ctype.h>
#include <stdarg.h>
#include <stdio.h>
#include <stdlib.h>
#include <string.h>

#include <zephyr/drivers/hwinfo.h>
#include <zephyr/kernel.h>

#define FW_NAME    "k64f-hid-injector"
#define FW_VERSION "0.1.0"

#define LINE_MAX   160
#define TAP_MS     12      /* how long a tapped key or click is held */

struct keyname {
	const char *name;
	uint8_t usage;
};

/* Non-printing and navigation keys, by name. */
static const struct keyname named_keys[] = {
	{ "ENTER", 0x28 }, { "RETURN", 0x28 }, { "ESC", 0x29 },
	{ "BACKSPACE", 0x2A }, { "BKSP", 0x2A }, { "TAB", 0x2B },
	{ "SPACE", 0x2C }, { "CAPSLOCK", 0x39 },
	{ "F1", 0x3A }, { "F2", 0x3B }, { "F3", 0x3C }, { "F4", 0x3D },
	{ "F5", 0x3E }, { "F6", 0x3F }, { "F7", 0x40 }, { "F8", 0x41 },
	{ "F9", 0x42 }, { "F10", 0x43 }, { "F11", 0x44 }, { "F12", 0x45 },
	{ "PRTSCR", 0x46 }, { "SCROLLLOCK", 0x47 }, { "PAUSE", 0x48 },
	{ "INSERT", 0x49 }, { "HOME", 0x4A }, { "PGUP", 0x4B },
	{ "DELETE", 0x4C }, { "DEL", 0x4C }, { "END", 0x4D }, { "PGDN", 0x4E },
	{ "RIGHT", 0x4F }, { "LEFT", 0x50 }, { "DOWN", 0x51 }, { "UP", 0x52 },
	/*
	 * Keyboard Application, the "menu" key beside right ctrl. Worth naming
	 * explicitly because it is the only key a boot-protocol keyboard can
	 * send that Android turns into KEYCODE_MENU: HID 0x65 -> Linux
	 * KEY_COMPOSE (127) -> "key 127 MENU" in frameworks Generic.kl. Android
	 * BACK and HOME are not reachable from this interface at all, since
	 * those need Consumer Page AC Back / AC Home.
	 */
	{ "MENU", 0x65 }, { "APP", 0x65 }, { "APPLICATION", 0x65 }, { "COMPOSE", 0x65 },
};

/* Printable ASCII 0x20..0x7E -> usage code, and whether shift is needed. */
static bool ascii_to_usage(char c, uint8_t *usage, bool *shift)
{
	*shift = false;

	if (c >= 'a' && c <= 'z') {
		*usage = 0x04 + (c - 'a');
		return true;
	}
	if (c >= 'A' && c <= 'Z') {
		*usage = 0x04 + (c - 'A');
		*shift = true;
		return true;
	}
	if (c >= '1' && c <= '9') {
		*usage = 0x1E + (c - '1');
		return true;
	}

	switch (c) {
	case '0':  *usage = 0x27; return true;
	case ' ':  *usage = 0x2C; return true;
	case '-':  *usage = 0x2D; return true;
	case '=':  *usage = 0x2E; return true;
	case '[':  *usage = 0x2F; return true;
	case ']':  *usage = 0x30; return true;
	case '\\': *usage = 0x31; return true;
	case ';':  *usage = 0x33; return true;
	case '\'': *usage = 0x34; return true;
	case '`':  *usage = 0x35; return true;
	case ',':  *usage = 0x36; return true;
	case '.':  *usage = 0x37; return true;
	case '/':  *usage = 0x38; return true;
	/* Shifted forms of the above. */
	case '!':  *usage = 0x1E; *shift = true; return true;
	case '@':  *usage = 0x1F; *shift = true; return true;
	case '#':  *usage = 0x20; *shift = true; return true;
	case '$':  *usage = 0x21; *shift = true; return true;
	case '%':  *usage = 0x22; *shift = true; return true;
	case '^':  *usage = 0x23; *shift = true; return true;
	case '&':  *usage = 0x24; *shift = true; return true;
	case '*':  *usage = 0x25; *shift = true; return true;
	case '(':  *usage = 0x26; *shift = true; return true;
	case ')':  *usage = 0x27; *shift = true; return true;
	case '_':  *usage = 0x2D; *shift = true; return true;
	case '+':  *usage = 0x2E; *shift = true; return true;
	case '{':  *usage = 0x2F; *shift = true; return true;
	case '}':  *usage = 0x30; *shift = true; return true;
	case '|':  *usage = 0x31; *shift = true; return true;
	case ':':  *usage = 0x33; *shift = true; return true;
	case '"':  *usage = 0x34; *shift = true; return true;
	case '~':  *usage = 0x35; *shift = true; return true;
	case '<':  *usage = 0x36; *shift = true; return true;
	case '>':  *usage = 0x37; *shift = true; return true;
	case '?':  *usage = 0x38; *shift = true; return true;
	default:   return false;
	}
}

static bool name_to_modifier(const char *tok, uint8_t *mod)
{
	if (!strcmp(tok, "CTRL") || !strcmp(tok, "CONTROL")) {
		*mod = MOD_LCTRL;
	} else if (!strcmp(tok, "SHIFT")) {
		*mod = MOD_LSHIFT;
	} else if (!strcmp(tok, "ALT")) {
		*mod = MOD_LALT;
	} else if (!strcmp(tok, "GUI") || !strcmp(tok, "WIN") ||
		   !strcmp(tok, "META") || !strcmp(tok, "SUPER")) {
		*mod = MOD_LGUI;
	} else {
		return false;
	}

	return true;
}

static bool name_to_usage(const char *tok, uint8_t *usage)
{
	for (size_t i = 0; i < ARRAY_SIZE(named_keys); i++) {
		if (!strcmp(tok, named_keys[i].name)) {
			*usage = named_keys[i].usage;
			return true;
		}
	}

	/* A single printable character is also a valid key name. */
	if (strlen(tok) == 1) {
		bool shift;

		return ascii_to_usage(tok[0], usage, &shift);
	}

	return false;
}

/*
 * Parse "ctrl+alt+t" into a modifier mask and at most one ordinary key.
 * Returns false if any element is unrecognised.
 */
static bool parse_combo(char *spec, uint8_t *mod, uint8_t *usage)
{
	char *save = NULL;
	char *tok;

	*mod = 0U;
	*usage = 0U;

	for (tok = strtok_r(spec, "+", &save); tok != NULL;
	     tok = strtok_r(NULL, "+", &save)) {
		uint8_t m, u;

		if (name_to_modifier(tok, &m)) {
			*mod |= m;
		} else if (name_to_usage(tok, &u)) {
			if (*usage != 0U) {
				return false;   /* more than one ordinary key */
			}
			*usage = u;
		} else {
			return false;
		}
	}

	return true;
}

static bool parse_button(const char *tok, uint8_t *mask)
{
	if (!strcmp(tok, "LEFT") || !strcmp(tok, "L")) {
		*mask = MOUSE_LEFT;
	} else if (!strcmp(tok, "RIGHT") || !strcmp(tok, "R")) {
		*mask = MOUSE_RIGHT;
	} else if (!strcmp(tok, "MIDDLE") || !strcmp(tok, "M")) {
		*mask = MOUSE_MIDDLE;
	} else {
		return false;
	}

	return true;
}

static void emit(cmd_reply_fn reply, void *ctx, const char *fmt, ...)
{
	char buf[LINE_MAX];
	va_list ap;

	va_start(ap, fmt);
	vsnprintk(buf, sizeof(buf), fmt, ap);
	va_end(ap);

	reply(ctx, buf);
}

static void report_result(cmd_reply_fn reply, void *ctx, int ret,
			  const char *what)
{
	if (ret == 0) {
		emit(reply, ctx, "OK %s", what);
	} else if (ret == -EAGAIN) {
		emit(reply, ctx, "ERR USB NOT READY (host has not configured "
				 "the HID interfaces)");
	} else if (ret == -ENOSPC) {
		emit(reply, ctx, "ERR TOO MANY KEYS HELD (max %d)", KBD_MAX_KEYS);
	} else {
		emit(reply, ctx, "ERR %s FAILED %d", what, ret);
	}
}

static void print_help(cmd_reply_fn reply, void *ctx)
{
	reply(ctx, "commands (verbs case-insensitive, one per line):");
	reply(ctx, "  TYPE <text>         type the rest of the line literally");
	reply(ctx, "  KEY <combo>         press and release, e.g. KEY ctrl+alt+t");
	reply(ctx, "  KEYDOWN <combo>     press and hold");
	reply(ctx, "  KEYUP <combo>       release");
	reply(ctx, "  RELEASE             release every held key and button");
	reply(ctx, "  MOUSE MOVE <dx> <dy>    relative, -127..127 per report");
	reply(ctx, "  MOUSE SCROLL <n>        wheel clicks, -127..127");
	reply(ctx, "  MOUSE CLICK <button>    left | right | middle");
	reply(ctx, "  MOUSE DOWN|UP <button>");
	reply(ctx, "  STATE               held modifiers and buttons");
	reply(ctx, "  INFO                firmware, board, USB state, serial");
	reply(ctx, "  VERSION             firmware name and version");
	reply(ctx, "  HELP                this text");
	reply(ctx, "key names: a-z 0-9, punctuation, enter esc tab space backspace");
	reply(ctx, "           del home end pgup pgdn up down left right f1-f12");
	reply(ctx, "           menu (aliases: app application compose) = KEYCODE_MENU");
	reply(ctx, "modifiers: ctrl shift alt gui (aliases: control win meta super)");
}

static void print_info(cmd_reply_fn reply, void *ctx)
{
	uint8_t id[12];
	char hex[sizeof(id) * 2 + 1];
	ssize_t len;

	len = hwinfo_get_device_id(id, sizeof(id));
	if (len <= 0) {
		strcpy(hex, "unknown");
	} else {
		for (ssize_t i = 0; i < len; i++) {
			snprintk(&hex[i * 2], 3, "%02X", id[i]);
		}
	}

	emit(reply, ctx, "OK INFO fw=%s ver=%s board=%s usb=%s serial=%s",
	     FW_NAME, FW_VERSION, CONFIG_BOARD,
	     hid_io_ready() ? "ready" : "down", hex);
}

void command_execute(const char *raw, cmd_reply_fn reply, void *ctx)
{
	char work[LINE_MAX];        /* uppercased, tokenised */
	char original[LINE_MAX];    /* untouched, for TYPE */
	char *tok[5];
	int n = 0;

	if (raw == NULL) {
		return;
	}

	strncpy(original, raw, sizeof(original) - 1);
	original[sizeof(original) - 1] = '\0';
	strncpy(work, raw, sizeof(work) - 1);
	work[sizeof(work) - 1] = '\0';

	for (char *p = work; *p != '\0'; p++) {
		*p = (char)toupper((unsigned char)*p);
	}

	/* TYPE is handled before tokenising, since its argument is the rest of
	   the line verbatim -- spaces, case and all. */
	if (!strncmp(work, "TYPE ", 5)) {
		const char *text = original + 5;
		int ret = 0;

		for (const char *c = text; *c != '\0' && ret == 0; c++) {
			uint8_t usage;
			bool shift;

			if (!ascii_to_usage(*c, &usage, &shift)) {
				emit(reply, ctx,
				     "ERR UNTYPEABLE CHARACTER 0x%02X", *c);
				return;
			}
			ret = hid_kbd_tap(shift ? MOD_LSHIFT : 0U, usage, TAP_MS);
		}
		report_result(reply, ctx, ret, "TYPE");
		return;
	}

	{
		char *save = NULL;

		for (char *t = strtok_r(work, " \t", &save);
		     t != NULL && n < (int)ARRAY_SIZE(tok);
		     t = strtok_r(NULL, " \t", &save)) {
			tok[n++] = t;
		}
	}

	if (n == 0) {
		return;                 /* blank line: stay quiet */
	}

	if (!strcmp(tok[0], "HELP") || !strcmp(tok[0], "?")) {
		print_help(reply, ctx);
		return;
	}
	if (!strcmp(tok[0], "VERSION")) {
		emit(reply, ctx, "%s %s", FW_NAME, FW_VERSION);
		return;
	}
	if (!strcmp(tok[0], "INFO")) {
		print_info(reply, ctx);
		return;
	}
	if (!strcmp(tok[0], "STATE")) {
		emit(reply, ctx, "STATE mods=0x%02X buttons=0x%02X usb=%s",
		     hid_kbd_modifiers(), hid_mouse_button_state(),
		     hid_io_ready() ? "ready" : "down");
		return;
	}
	if (!strcmp(tok[0], "RELEASE")) {
		int ret = hid_kbd_release_all();

		if (ret == 0) {
			ret = hid_mouse_buttons(0U);
		}
		report_result(reply, ctx, ret, "RELEASE");
		return;
	}

	if (!strcmp(tok[0], "KEY") || !strcmp(tok[0], "KEYDOWN") ||
	    !strcmp(tok[0], "KEYUP")) {
		uint8_t mod, usage;
		int ret;

		if (n < 2) {
			emit(reply, ctx, "ERR %s NEEDS A KEY", tok[0]);
			return;
		}
		if (!parse_combo(tok[1], &mod, &usage)) {
			emit(reply, ctx, "ERR BAD KEY COMBO");
			return;
		}

		if (!strcmp(tok[0], "KEYDOWN")) {
			ret = hid_kbd_press(mod, usage);
		} else if (!strcmp(tok[0], "KEYUP")) {
			ret = hid_kbd_release(mod, usage);
		} else {
			ret = hid_kbd_tap(mod, usage, TAP_MS);
		}
		report_result(reply, ctx, ret, tok[0]);
		return;
	}

	if (!strcmp(tok[0], "MOUSE")) {
		if (n < 2) {
			emit(reply, ctx, "ERR MOUSE NEEDS A SUBCOMMAND");
			return;
		}

		if (!strcmp(tok[1], "MOVE")) {
			if (n < 4) {
				emit(reply, ctx, "ERR MOUSE MOVE NEEDS DX AND DY");
				return;
			}
			report_result(reply, ctx,
				      hid_mouse_move(atoi(tok[2]), atoi(tok[3]), 0),
				      "MOUSE MOVE");
			return;
		}
		if (!strcmp(tok[1], "SCROLL")) {
			if (n < 3) {
				emit(reply, ctx, "ERR MOUSE SCROLL NEEDS AN AMOUNT");
				return;
			}
			report_result(reply, ctx, hid_mouse_move(0, 0, atoi(tok[2])),
				      "MOUSE SCROLL");
			return;
		}

		if (!strcmp(tok[1], "CLICK") || !strcmp(tok[1], "DOWN") ||
		    !strcmp(tok[1], "UP")) {
			uint8_t mask;
			int ret;

			if (n < 3) {
				emit(reply, ctx, "ERR MOUSE %s NEEDS A BUTTON",
				     tok[1]);
				return;
			}
			if (!parse_button(tok[2], &mask)) {
				emit(reply, ctx, "ERR BAD BUTTON %s", tok[2]);
				return;
			}

			if (!strcmp(tok[1], "CLICK")) {
				ret = hid_mouse_click(mask, TAP_MS);
			} else if (!strcmp(tok[1], "DOWN")) {
				ret = hid_mouse_buttons(
					hid_mouse_button_state() | mask);
			} else {
				ret = hid_mouse_buttons(
					hid_mouse_button_state() & (uint8_t)~mask);
			}
			report_result(reply, ctx, ret, "MOUSE");
			return;
		}

		emit(reply, ctx, "ERR UNKNOWN MOUSE SUBCOMMAND %s", tok[1]);
		return;
	}

	emit(reply, ctx, "ERR UNKNOWN COMMAND %s", tok[0]);
}
```

## src/command.h
```c
/* SPDX-License-Identifier: Apache-2.0 */
#ifndef K64F_HID_COMMAND_H_
#define K64F_HID_COMMAND_H_

/*
 * The command layer is deliberately transport-agnostic: it is handed a line
 * and a way to reply, so the same parser serves the OpenSDA serial console
 * today and a TCP listener on the Ethernet port later.
 */
typedef void (*cmd_reply_fn)(void *ctx, const char *line);

void command_execute(const char *raw, cmd_reply_fn reply, void *ctx);

#endif /* K64F_HID_COMMAND_H_ */
```

## src/hid_io.c
```c
/*
 * The two HID interfaces and the report state behind them.
 *
 * Reports are submitted synchronously: no input_report_done callback is
 * registered, so hid_device_submit_report() blocks until the report is on the
 * wire. That matters for injection, where a press must reach the host before
 * the matching release is queued.
 *
 * SPDX-License-Identifier: Apache-2.0
 */

#include "hid_io.h"

#include <string.h>

#include <zephyr/device.h>
#include <zephyr/kernel.h>
#include <zephyr/usb/class/usbd_hid.h>
#include <zephyr/usb/class/hid.h>

#include <zephyr/logging/log.h>
LOG_MODULE_REGISTER(hid_io, LOG_LEVEL_WRN);

static const uint8_t kbd_report_desc[] = HID_KEYBOARD_REPORT_DESC();
static const uint8_t mouse_report_desc[] = HID_MOUSE_REPORT_DESC(3);

static const struct device *kbd_dev;
static const struct device *mouse_dev;

static atomic_t kbd_ready;
static atomic_t mouse_ready;

/* [0] modifiers, [1] reserved, [2..7] key usages. Aligned: the HID API
   requires an aligned report buffer. */
static uint8_t __aligned(4) kbd_report[8];
/* [0] buttons, [1] dx, [2] dy, [3] wheel. */
static uint8_t __aligned(4) mouse_report[4];

static struct k_mutex lock;

/* Last LED state the host set, so Get Report can echo it back. */
static uint8_t kbd_leds;
/* Boot (0) or Report (1) protocol, as selected by the host. */
static uint8_t kbd_protocol = 1U;
static uint8_t mouse_protocol = 1U;

static void kbd_iface_ready(const struct device *dev, const bool ready)
{
	ARG_UNUSED(dev);
	atomic_set(&kbd_ready, ready ? 1 : 0);
}

static void mouse_iface_ready(const struct device *dev, const bool ready)
{
	ARG_UNUSED(dev);
	atomic_set(&mouse_ready, ready ? 1 : 0);
}

/*
 * The host sets keyboard LEDs (caps/num lock) through this. Nothing here
 * drives LEDs, but the request must be accepted or the host logs an error.
 */
static int kbd_set_report(const struct device *dev, const uint8_t type,
			  const uint8_t id, const uint16_t len,
			  const uint8_t *const buf)
{
	ARG_UNUSED(dev);
	ARG_UNUSED(id);

	if (type != HID_REPORT_TYPE_OUTPUT) {
		return -ENOTSUP;
	}
	if (len >= 1U && buf != NULL) {
		kbd_leds = buf[0];
	}

	return 0;
}

/*
 * Get Report is mandatory for every HID device, and Set Protocol is mandatory
 * for any interface that declares boot protocol -- which both of these do.
 * Omitting either makes hid_device_register() fail with -EINVAL.
 */
static int kbd_get_report(const struct device *dev, const uint8_t type,
			  const uint8_t id, const uint16_t len,
			  uint8_t *const buf)
{
	ARG_UNUSED(dev);
	ARG_UNUSED(id);

	if (type == HID_REPORT_TYPE_INPUT) {
		if (len < sizeof(kbd_report)) {
			return -ENOBUFS;
		}
		k_mutex_lock(&lock, K_FOREVER);
		memcpy(buf, kbd_report, sizeof(kbd_report));
		k_mutex_unlock(&lock);
		return (int)sizeof(kbd_report);
	}

	if (type == HID_REPORT_TYPE_OUTPUT) {
		if (len < 1U) {
			return -ENOBUFS;
		}
		buf[0] = kbd_leds;
		return 1;
	}

	return -ENOTSUP;
}

static int mouse_get_report(const struct device *dev, const uint8_t type,
			    const uint8_t id, const uint16_t len,
			    uint8_t *const buf)
{
	ARG_UNUSED(dev);
	ARG_UNUSED(id);

	if (type != HID_REPORT_TYPE_INPUT) {
		return -ENOTSUP;
	}
	if (len < sizeof(mouse_report)) {
		return -ENOBUFS;
	}

	k_mutex_lock(&lock, K_FOREVER);
	memcpy(buf, mouse_report, sizeof(mouse_report));
	k_mutex_unlock(&lock);

	return (int)sizeof(mouse_report);
}

static void kbd_set_protocol(const struct device *dev, const uint8_t proto)
{
	ARG_UNUSED(dev);
	kbd_protocol = proto;
}

static void mouse_set_protocol(const struct device *dev, const uint8_t proto)
{
	ARG_UNUSED(dev);
	mouse_protocol = proto;
}

static const struct hid_device_ops kbd_ops = {
	.iface_ready = kbd_iface_ready,
	.get_report = kbd_get_report,
	.set_report = kbd_set_report,
	.set_protocol = kbd_set_protocol,
};

static const struct hid_device_ops mouse_ops = {
	.iface_ready = mouse_iface_ready,
	.get_report = mouse_get_report,
	.set_protocol = mouse_set_protocol,
};

bool hid_io_ready(void)
{
	return atomic_get(&kbd_ready) && atomic_get(&mouse_ready);
}

static int kbd_flush(void)
{
	if (!atomic_get(&kbd_ready)) {
		return -EAGAIN;
	}

	return hid_device_submit_report(kbd_dev, sizeof(kbd_report), kbd_report);
}

static int mouse_flush(void)
{
	if (!atomic_get(&mouse_ready)) {
		return -EAGAIN;
	}

	return hid_device_submit_report(mouse_dev, sizeof(mouse_report),
					mouse_report);
}

uint8_t hid_kbd_modifiers(void)
{
	return kbd_report[0];
}

uint8_t hid_mouse_button_state(void)
{
	return mouse_report[0];
}

int hid_kbd_press(uint8_t mod, uint8_t usage)
{
	int ret;

	k_mutex_lock(&lock, K_FOREVER);
	kbd_report[0] |= mod;

	if (usage != 0U) {
		int slot = -1;

		for (int i = 2; i < 8; i++) {
			if (kbd_report[i] == usage) {
				slot = i;       /* already held */
				break;
			}
			if (kbd_report[i] == 0U && slot < 0) {
				slot = i;
			}
		}
		if (slot < 0) {
			k_mutex_unlock(&lock);
			return -ENOSPC;         /* six keys already held */
		}
		kbd_report[slot] = usage;
	}

	ret = kbd_flush();
	k_mutex_unlock(&lock);

	return ret;
}

int hid_kbd_release(uint8_t mod, uint8_t usage)
{
	int ret;

	k_mutex_lock(&lock, K_FOREVER);
	kbd_report[0] &= (uint8_t)~mod;

	if (usage != 0U) {
		for (int i = 2; i < 8; i++) {
			if (kbd_report[i] == usage) {
				kbd_report[i] = 0U;
			}
		}
	}

	ret = kbd_flush();
	k_mutex_unlock(&lock);

	return ret;
}

int hid_kbd_release_all(void)
{
	int ret;

	k_mutex_lock(&lock, K_FOREVER);
	memset(kbd_report, 0, sizeof(kbd_report));
	ret = kbd_flush();
	k_mutex_unlock(&lock);

	return ret;
}

int hid_kbd_tap(uint8_t mod, uint8_t usage, uint32_t hold_ms)
{
	int ret;

	ret = hid_kbd_press(mod, usage);
	if (ret) {
		return ret;
	}

	if (hold_ms != 0U) {
		k_msleep(hold_ms);
	}

	return hid_kbd_release(mod, usage);
}

static int8_t clamp_delta(int v)
{
	/* The report descriptor declares a signed byte per axis. */
	if (v > 127) {
		return 127;
	}
	if (v < -127) {
		return -127;
	}

	return (int8_t)v;
}

int hid_mouse_move(int dx, int dy, int wheel)
{
	int ret;

	k_mutex_lock(&lock, K_FOREVER);
	mouse_report[1] = (uint8_t)clamp_delta(dx);
	mouse_report[2] = (uint8_t)clamp_delta(dy);
	mouse_report[3] = (uint8_t)clamp_delta(wheel);
	ret = mouse_flush();

	/* Movement is relative: clear it so the next report does not repeat it. */
	mouse_report[1] = 0U;
	mouse_report[2] = 0U;
	mouse_report[3] = 0U;
	k_mutex_unlock(&lock);

	return ret;
}

int hid_mouse_buttons(uint8_t mask)
{
	int ret;

	k_mutex_lock(&lock, K_FOREVER);
	mouse_report[0] = mask;
	ret = mouse_flush();
	k_mutex_unlock(&lock);

	return ret;
}

int hid_mouse_click(uint8_t mask, uint32_t hold_ms)
{
	int ret;

	ret = hid_mouse_buttons(mouse_report[0] | mask);
	if (ret) {
		return ret;
	}

	if (hold_ms != 0U) {
		k_msleep(hold_ms);
	}

	return hid_mouse_buttons(mouse_report[0] & (uint8_t)~mask);
}

int hid_io_init(void)
{
	int ret;

	k_mutex_init(&lock);

	kbd_dev = DEVICE_DT_GET(DT_NODELABEL(hid_kbd));
	mouse_dev = DEVICE_DT_GET(DT_NODELABEL(hid_mouse));

	if (!device_is_ready(kbd_dev) || !device_is_ready(mouse_dev)) {
		LOG_ERR("HID devices not ready");
		return -ENODEV;
	}

	ret = hid_device_register(kbd_dev, kbd_report_desc,
				  sizeof(kbd_report_desc), &kbd_ops);
	if (ret) {
		LOG_ERR("keyboard register: %d", ret);
		return ret;
	}

	ret = hid_device_register(mouse_dev, mouse_report_desc,
				  sizeof(mouse_report_desc), &mouse_ops);
	if (ret) {
		LOG_ERR("mouse register: %d", ret);
		return ret;
	}

	return 0;
}
```

## src/hid_io.h
```c
/* SPDX-License-Identifier: Apache-2.0 */
#ifndef K64F_HID_IO_H_
#define K64F_HID_IO_H_

#include <stdbool.h>
#include <stdint.h>

/* Modifier bits, matching the HID keyboard report's first byte. */
#define MOD_LCTRL  0x01
#define MOD_LSHIFT 0x02
#define MOD_LALT   0x04
#define MOD_LGUI   0x08

#define MOUSE_LEFT   0x01
#define MOUSE_RIGHT  0x02
#define MOUSE_MIDDLE 0x04

/* Up to six non-modifier keys can be held at once, per the boot report. */
#define KBD_MAX_KEYS 6

int  hid_io_init(void);
bool hid_io_ready(void);

/* All of these return 0, or a negative errno. */
int hid_kbd_press(uint8_t mod, uint8_t usage);
int hid_kbd_release(uint8_t mod, uint8_t usage);
int hid_kbd_release_all(void);
int hid_kbd_tap(uint8_t mod, uint8_t usage, uint32_t hold_ms);

int hid_mouse_move(int dx, int dy, int wheel);
int hid_mouse_buttons(uint8_t mask);
int hid_mouse_click(uint8_t mask, uint32_t hold_ms);

uint8_t hid_kbd_modifiers(void);
uint8_t hid_mouse_button_state(void);

#endif /* K64F_HID_IO_H_ */
```

## src/usbd_ctx.c
```c
/*
 * USB device context for the HID injector.
 *
 * SPDX-License-Identifier: Apache-2.0
 */

#include "usbd_ctx.h"

#include <zephyr/logging/log.h>
LOG_MODULE_REGISTER(usbd_ctx, LOG_LEVEL_WRN);

USBD_DEVICE_DEFINE(k64f_usbd,
		   DEVICE_DT_GET(DT_NODELABEL(zephyr_udc0)),
		   K64F_HID_VID, K64F_HID_PID);

USBD_DESC_LANG_DEFINE(k64f_lang);
USBD_DESC_MANUFACTURER_DEFINE(k64f_mfr, "jetson-bench");
USBD_DESC_PRODUCT_DEFINE(k64f_product, "FRDM-K64F HID injector");
USBD_DESC_SERIAL_NUMBER_DEFINE(k64f_sn);
USBD_DESC_CONFIG_DEFINE(k64f_fs_desc, "HID injector FS configuration");

/*
 * Bus powered, no remote wakeup, so bmAttributes contributes nothing. This has
 * to be a literal: USBD_CONFIGURATION_DEFINE builds a static initialiser, and
 * a const variable is not a constant expression there.
 */
#define K64F_CFG_ATTRIBUTES 0
#define K64F_CFG_MAX_POWER  250

USBD_CONFIGURATION_DEFINE(k64f_fs_config, K64F_CFG_ATTRIBUTES,
			  K64F_CFG_MAX_POWER, &k64f_fs_desc);

struct usbd_context *k64f_usbd_init(void)
{
	int err;

	err = usbd_add_descriptor(&k64f_usbd, &k64f_lang);
	if (err) {
		LOG_ERR("language descriptor: %d", err);
		return NULL;
	}

	err = usbd_add_descriptor(&k64f_usbd, &k64f_mfr);
	if (err) {
		LOG_ERR("manufacturer descriptor: %d", err);
		return NULL;
	}

	err = usbd_add_descriptor(&k64f_usbd, &k64f_product);
	if (err) {
		LOG_ERR("product descriptor: %d", err);
		return NULL;
	}

	err = usbd_add_descriptor(&k64f_usbd, &k64f_sn);
	if (err) {
		LOG_ERR("serial number descriptor: %d", err);
		return NULL;
	}

	err = usbd_add_configuration(&k64f_usbd, USBD_SPEED_FS, &k64f_fs_config);
	if (err) {
		LOG_ERR("add configuration: %d", err);
		return NULL;
	}

	err = usbd_register_all_classes(&k64f_usbd, USBD_SPEED_FS, 1, NULL);
	if (err) {
		LOG_ERR("register classes: %d", err);
		return NULL;
	}

	/* Take the class codes from the interface descriptors. */
	usbd_device_set_code_triple(&k64f_usbd, USBD_SPEED_FS, 0, 0, 0);

	err = usbd_init(&k64f_usbd);
	if (err) {
		LOG_ERR("usbd_init: %d", err);
		return NULL;
	}

	return &k64f_usbd;
}
```

## src/usbd_ctx.h
```c
/* SPDX-License-Identifier: Apache-2.0 */
#ifndef K64F_HID_USBD_CTX_H_
#define K64F_HID_USBD_CTX_H_

#include <zephyr/usb/usbd.h>

/*
 * Placeholder identifiers. 0x2fe3 is the Zephyr project's vendor id, which is
 * fine on a private bench but must not be shipped: get a real VID/PID before
 * this leaves the lab.
 */
#define K64F_HID_VID 0x2fe3
#define K64F_HID_PID 0x0001

/* Build the device context and run usbd_init(). NULL on failure. */
struct usbd_context *k64f_usbd_init(void);

#endif /* K64F_HID_USBD_CTX_H_ */
```
